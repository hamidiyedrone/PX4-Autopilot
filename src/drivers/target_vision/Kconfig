## src/drivers/target_vision/Kconfig
```kconfig
menuconfig DRIVERS_TARGET_VISION
	bool "target_vision"
	default n
	---help---
		Link to the vision computer that detects the target (UART, or UDP in SITL)
```

## src/modules/intercept/Kconfig
```kconfig
menuconfig MODULES_INTERCEPT
	bool "intercept"
	default n
	---help---
		Enable support for intercept flight mode
```
